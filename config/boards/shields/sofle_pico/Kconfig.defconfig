## config/boards/shields/sofle_pico/Kconfig.defconfig
```kconfig
if SHIELD_SOFLE_PICO_LEFT

config ZMK_KEYBOARD_NAME
    default "Sofle Pico"

config ZMK_SPLIT_ROLE_CENTRAL
    default y

endif

if SHIELD_SOFLE_PICO_LEFT || SHIELD_SOFLE_PICO_RIGHT

config ZMK_SPLIT
    default y

endif
```

## config/boards/shields/sofle_pico/Kconfig.shield
```kconfig
if SHIELD_SOFLE_PICO_LEFT

config ZMK_KEYBOARD_NAME
    default "Sofle Pico"

config ZMK_SPLIT_ROLE_CENTRAL
    default y

endif

if SHIELD_SOFLE_PICO_LEFT || SHIELD_SOFLE_PICO_RIGHT

config ZMK_SPLIT
    default y

endif

config SHIELD_SOFLE_PICO_LEFT
    def_bool $(shields_list_contains,sofle_pico_left)

config SHIELD_SOFLE_PICO_RIGHT
    def_bool $(shields_list_contains,sofle_pico_right)
```

## config/boards/shields/sofle_pico_left/Kconfig.defconfig
```kconfig
if SHIELD_SOFLE_PICO_LEFT
 
config ZMK_KEYBOARD_NAME
    default "Sofle Pico"
 
config ZMK_SPLIT_ROLE_CENTRAL
    default y
 
config ZMK_SPLIT
    default y
 
endif
```

## config/boards/shields/sofle_pico_left/Kconfig.shield
```kconfig
config SHIELD_SOFLE_PICO_LEFT
    def_bool $(shields_list_contains,sofle_pico_left)
```

## config/boards/shields/sofle_pico_right/Kconfig.defconfig
```kconfig
if SHIELD_SOFLE_PICO_RIGHT
 
config ZMK_KEYBOARD_NAME
    default "Sofle Pico"
 
config ZMK_SPLIT
    default y
 
endif
```

## config/boards/shields/sofle_pico_right/Kconfig.shield
```kconfig
config SHIELD_SOFLE_PICO_RIGHT
    def_bool $(shields_list_contains,sofle_pico_right)
```
